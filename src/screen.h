#ifndef SCREEN_H
#define SCREEN_H

#include <TFT_eSPI.h>
#include <SPI.h>

extern TFT_eSPI tft;
extern bool g_colorInvert;
inline uint16_t fixColor(uint16_t color) {
    return g_colorInvert ? (~color & 0xFFFF) : color;
}
extern SemaphoreHandle_t sdMutex;

// ============================================================
// Color definitions
// ============================================================
#define COLOR_BLACK     0x0000
#define COLOR_WHITE     0xFFFF
#define COLOR_RED       0xF800
#define COLOR_GREEN     0x07E0
#define COLOR_BLUE      0x001F
#define COLOR_YELLOW    0xFFE0
#define COLOR_CYAN      0x07FF
#define COLOR_MAGENTA   0xF81F
#define COLOR_ORANGE    0xFD20
#define COLOR_PURPLE    0x801F
#define COLOR_GRAY      0x8410
#define COLOR_LIGHTGRAY 0xC618
#define COLOR_DARKGRAY  0x4208

// ============================================================
// 5x7 bitmap font (ASCII 32-127) - legacy fallback
// ============================================================
static const unsigned char font5x7[96][5] = {
    {0x00,0x00,0x00,0x00,0x00}, // 32 space
    {0x00,0x00,0x4F,0x00,0x00}, // 33 !
    {0x00,0x07,0x00,0x07,0x00}, // 34 "
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    {0x44,0x64,0x54,0x4C,0x44}  // 122 z
};

inline void screen_draw_char(int x, int y, char c, uint16_t color, uint8_t size) {
    if (c < 32 || c > 127) c = 32;
    c -= 32;
    uint16_t col = fixColor(color);
    
    for (int row = 0; row < 5; row++) {
        uint8_t line = font5x7[(uint8_t)c][row];
        for (int col_bit = 0; col_bit < 7; col_bit++) {
            if (line & (1 << (6 - col_bit))) {
                int draw_y = y + (6 - col_bit) * size;
                for (int sx = 0; sx < size; sx++) {
                    for (int sy = 0; sy < size; sy++) {
                        tft.drawPixel(x + row * size + sx, draw_y + sy, col);
                    }
                }
            }
        }
    }
}

inline void drawtext(int x, int y, const char *str, uint16_t color, uint8_t size = 1) {
    while (*str) {
        screen_draw_char(x, y, *str, color, size);
        x += 6 * size;
        str++;
    }
}

inline void screen_init(uint8_t rotation = 0) {
    tft.init();
    tft.setRotation(0);
    tft.fillScreen(fixColor(COLOR_BLACK));
}

inline void fillscreen(uint16_t color) {
    tft.fillScreen(fixColor(color));
}

inline void fillrect(int32_t x, int32_t y, int32_t w, int32_t h, uint16_t color) {
    tft.fillRect(x, y, w, h, fixColor(color));
    yield();
}

inline void drawrect(int32_t x, int32_t y, int32_t w, int32_t h, uint16_t color) {
    tft.drawRect(x, y, w, h, fixColor(color));
}

inline void drawcircle(int32_t x, int32_t y, int32_t r, uint16_t color) {
    tft.drawCircle(x, y, r, fixColor(color));
}

inline void fillcircle(int32_t x, int32_t y, int32_t r, uint16_t color) {
    tft.fillCircle(x, y, r, fixColor(color));
}

inline void drawline(int32_t x1, int32_t y1, int32_t x2, int32_t y2, uint16_t color) {
    tft.drawLine(x1, y1, x2, y2, fixColor(color));
}

inline void drawpixel(int32_t x, int32_t y, uint16_t color) {
    tft.drawPixel(x, y, fixColor(color));
}

inline void settextsize(uint8_t size) {}


extern bool touch_init(void);
extern void touch_update(void);
extern bool touch_gesture_changed(void);
extern int touch_get_gesture(void);
extern void touch_get_point(int *x, int *y);

#endif